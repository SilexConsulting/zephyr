## boards/heltec/heltec_wireless_tracker/Kconfig.heltec_wireless_tracker
```kconfig
# Heltec Wireless Stick Lite (V3) board configuration
# SPDX-License-Identifier: Apache-2.0

config BOARD_HELTEC_WIRELESS_TRACKER
	select SOC_ESP32S3_FN8
	select SOC_ESP32S3_PROCPU if BOARD_HELTEC_WIRELESS_TRACKER_ESP32S3_PROCPU
	select SOC_ESP32S3_APPCPU if BOARD_HELTEC_WIRELESS_TRACKER_ESP32S3_APPCPU
```

## boards/heltec/heltec_wireless_tracker/board.yml
```yaml
board:
  name: heltec_wireless_tracker
  vendor: heltec
  socs:
    - name: esp32s3
```

## boards/heltec/heltec_wireless_tracker/heltec_wireless_tracker_procpu_defconfig
```kconfig
# SPDX-License-Identifier: Apache-2.0

CONFIG_MAIN_STACK_SIZE=2048
CONFIG_CLOCK_CONTROL=y
CONFIG_CONSOLE=y
CONFIG_GPIO=y
CONFIG_PWM=y
CONFIG_SERIAL=y
CONFIG_SPI=y
CONFIG_UART_CONSOLE=y
CONFIG_ST7735R=y
CONFIG_DISPLAY=y
CONFIG_LOG=y
CONFIG_DISPLAY_LOG_LEVEL_DBG=y
```
